## drivers/android/Kconfig
```kconfig
menu "Android"

config ANDROID
	bool "Android Drivers"
	---help---
	  Enable support for various drivers needed on the Android platform

if ANDROID

config ANDROID_BINDER_IPC
	bool "Android Binder IPC Driver"
	depends on MMU
	default n
	---help---
	  Binder is used in Android for both communication between processes,
	  and remote method invocation.

	  This means one Android process can call a method/routine in another
	  Android process, using Binder to identify, invoke and pass arguments
	  between said processes.

endif # if ANDROID

endmenu
```

## drivers/iio/trigger/Kconfig
```kconfig
#
# Industrial I/O standalone triggers
#
# When adding new entries keep the list in alphabetical order

menu "Triggers - standalone"

config IIO_HRTIMER_TRIGGER
	tristate "HRTIMER trigger"
	select IRQ_WORK
	help
	  Provides support for using HRTIMER entries as IIO triggers.
	  If unsure, say N (but it's safe to say "Y").

	  To compile this driver as a module, choose M here: the
	  module will be called iio-trig-hrtimer.

endmenu
```

## drivers/misc/mediatek/hall/Kconfig
```kconfig
#
# hall switch driver
#
menu "Meizu hall driver"

config MEIZU_HALL_SWITCH
	bool "meizu hall switch"
	default n

endmenu
```
